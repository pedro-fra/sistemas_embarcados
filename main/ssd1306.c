#include "ssd1306.h"
#include <string.h>
#include <stdio.h>
#include "esp_log.h"
#include "freertos/FreeRTOS.h"
#include "freertos/task.h"

#define SSD1306_ADDR 0x3C
#define I2C_MASTER_NUM 0
#define I2C_MASTER_TIMEOUT_MS 1000

static const char *TAG = "SSD1306";
static uint8_t display_buffer[SSD1306_WIDTH * SSD1306_HEIGHT / 8] = {0};

static const uint8_t font5x8[][5] = {
    {0x00, 0x00, 0x00, 0x00, 0x00}, // space
    {0x00, 0x00, 0x5f, 0x00, 0x00}, // !
    {0x00, 0x07, 0x00, 0x07, 0x00}, // "
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    {0x61, 0x51, 0x49, 0x45, 0x43}, // Z
};

static esp_err_t ssd1306_write_command(uint8_t command)
{
    uint8_t data[2] = {0x80, command};
    return i2c_master_write_to_device(I2C_MASTER_NUM, SSD1306_ADDR, data, 2,
                                     I2C_MASTER_TIMEOUT_MS / portTICK_PERIOD_MS);
}

static esp_err_t ssd1306_write_data(uint8_t* data, size_t len)
{
    uint8_t write_buf[len + 1];
    write_buf[0] = 0x40;
    memcpy(&write_buf[1], data, len);
    return i2c_master_write_to_device(I2C_MASTER_NUM, SSD1306_ADDR, write_buf, len + 1,
                                     I2C_MASTER_TIMEOUT_MS / portTICK_PERIOD_MS);
}

esp_err_t ssd1306_init(void)
{
    esp_err_t ret = ESP_OK;
    
    ret |= ssd1306_write_command(0xAE);
    ret |= ssd1306_write_command(0xD5);
    ret |= ssd1306_write_command(0x80);
    ret |= ssd1306_write_command(0xA8);
    ret |= ssd1306_write_command(0x3F);
    ret |= ssd1306_write_command(0xD3);
    ret |= ssd1306_write_command(0x00);
    ret |= ssd1306_write_command(0x40);
    ret |= ssd1306_write_command(0x8D);
    ret |= ssd1306_write_command(0x14);
    ret |= ssd1306_write_command(0x20);
    ret |= ssd1306_write_command(0x00);
    ret |= ssd1306_write_command(0xA1);
    ret |= ssd1306_write_command(0xC8);
    ret |= ssd1306_write_command(0xDA);
    ret |= ssd1306_write_command(0x12);
    ret |= ssd1306_write_command(0x81);
    ret |= ssd1306_write_command(0xCF);
    ret |= ssd1306_write_command(0xD9);
    ret |= ssd1306_write_command(0xF1);
    ret |= ssd1306_write_command(0xDB);
    ret |= ssd1306_write_command(0x40);
    ret |= ssd1306_write_command(0xA4);
    ret |= ssd1306_write_command(0xA6);
    ret |= ssd1306_write_command(0xAF);
    
    if (ret == ESP_OK) {
        ESP_LOGI(TAG, "SSD1306 inicializado com sucesso");
    }
    
    return ret;
}

esp_err_t ssd1306_clear_screen(void)
{
    memset(display_buffer, 0, sizeof(display_buffer));
    return ssd1306_update_display();
}

esp_err_t ssd1306_display_text(uint8_t line, const char* text)
{
    if (line >= 8) return ESP_ERR_INVALID_ARG;
    
    int x = 0;
    int y = line;
    
    for (int i = 0; text[i] != '\0' && x < (SSD1306_WIDTH / 6); i++) {
        char c = text[i];
        int char_index;
        
        if (c >= ' ' && c <= 'Z') {
            char_index = c - ' ';
        } else {
            char_index = 0;
        }
        
        for (int col = 0; col < 5; col++) {
            uint8_t column_data = font5x8[char_index][col];
            int buffer_index = (y * SSD1306_WIDTH) + (x * 6) + col;
            if (buffer_index < sizeof(display_buffer)) {
                display_buffer[buffer_index] = column_data;
            }
        }
        x++;
    }
    
    return ESP_OK;
}

esp_err_t ssd1306_update_display(void)
{
    esp_err_t ret = ESP_OK;
    
    for (int page = 0; page < 8; page++) {
        ret |= ssd1306_write_command(0xB0 + page);
        ret |= ssd1306_write_command(0x00);
        ret |= ssd1306_write_command(0x10);
        
        ret |= ssd1306_write_data(&display_buffer[page * SSD1306_WIDTH], SSD1306_WIDTH);
    }
    
    return ret;
}